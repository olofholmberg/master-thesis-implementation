## vm_build/conf/bblayers.conf
```bitbake
# POKY_BBLAYERS_CONF_VERSION is increased each time build/conf/bblayers.conf
# changes incompatibly
POKY_BBLAYERS_CONF_VERSION = "2"

BBPATH = "${TOPDIR}"
BBFILES ?= ""

BBLAYERS ?= " \
  /home/yoctouser/work/meta \
  /home/yoctouser/work/meta-poky \
  /home/yoctouser/work/meta-yocto-bsp \
  /home/yoctouser/work/meta-sel4 \
  "
```

## vm_build/meta-sel4/conf/layer.conf
```bitbake
# We have a conf and classes directory, add to BBPATH
BBPATH .= ":${LAYERDIR}"

# We have recipes-* directories, add to BBFILES
BBFILES += "${LAYERDIR}/recipes-*/*/*.bb \
           ${LAYERDIR}/recipes-*/*/*.bbappend \
           ${LAYERDIR}/recipes-*/*/*/*.bb \
           "

BBFILE_COLLECTIONS += "sel4"
BBFILE_PATTERN_sel4 = "^${LAYERDIR}/"
BBFILE_PRIORITY_sel4 = "99"
LAYERVERSION_sel4 = "1"

LAYERSERIES_COMPAT_sel4 = "hardknott"
```
